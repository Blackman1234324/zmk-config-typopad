## config/boards/shields/typopad/Kconfig.defconfig
```kconfig
if SHIELD_TYPOPAD

config ZMK_KEYBOARD_NAME
    default "TypoPad"

config ZMK_BLE
    default y

config ZMK_BATTERY_REPORTING
    default y

config BT_BAS
    default y

endif
```
